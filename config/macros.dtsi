macro_c_with_caron: macro_c_with_caron{
compatible = "zmk,behavior-macro";
label = "macro_c_with_caron";
#binding-cells = <0>;
bindings = <&mt LALT V>, <&kp C>;
};
macro_z_with_caron: macro_z_with_caron{
compatible = "zmk,behavior-macro";
label = "macro_z_with_caron";
#binding-cells = <0>;
bindings = <&mt LALT V>, <&kp Z>;
};
macro_s_with_caron: macro_s_with_caron{
compatible = "zmk,behavior-macro";
label = "macro_s_with_caron";
#binding-cells = <0>;
bindings = <&mt LALT V>, <&kp S>;
};